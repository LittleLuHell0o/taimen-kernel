## KernelSU/kernel/Kconfig
```kconfig
menu "KernelSU"

config KSU
    tristate "KernelSU function support"
    default y
    help
      Enable kernel-level root privileges on Android System.
      To compile as a module, choose M here: the
      module will be called kernelsu.

config KSU_DEBUG
    bool "KernelSU debug mode"
    depends on KSU
    default n
    help
      Enable KernelSU debug mode.

config KSU_MANUAL_SU
    bool "Use manual su"
    depends on KSU
    default y
    help
      Use manual su and authorize the corresponding command line and application via prctl

config KPM
    bool "Enable SukiSU KPM"
    depends on KSU && 64BIT
    default n
    help
      Enabling this option will activate the KPM feature of SukiSU.
      This option is suitable for scenarios where you need to force KPM to be enabled.
      but it may affect system stability.
    select KALLSYMS
    select KALLSYMS_ALL

config KSU_MANUAL_HOOK
    bool "Hook KernelSU manually"
    depends on KSU != m
    help
      If enabled, Hook required KernelSU syscalls with manually-patched function.


config KSU_SUSFS
	bool "KernelSU SUSFS support"
	depends on KSU
	default y
	help
	  SUSFS (sus_path / sus_mount / sus_kstat / try_umount / spoof_uname /
	  spoof_cmdline / open_redirect) for hiding KernelSU from apps.

if KSU_SUSFS

config KSU_SUSFS_SUS_PATH
	bool "SUSFS sus_path"
	default y

config KSU_SUSFS_SUS_MOUNT
	bool "SUSFS sus_mount"
	default y

config KSU_SUSFS_SUS_KSTAT
	bool "SUSFS sus_kstat"
	default y

config KSU_SUSFS_TRY_UMOUNT
	bool "SUSFS try_umount"
	default y

config KSU_SUSFS_SPOOF_UNAME
	bool "SUSFS spoof uname"
	default y

config KSU_SUSFS_ENABLE_LOG
	bool "SUSFS enable log"
	default y

config KSU_SUSFS_SPOOF_CMDLINE_OR_BOOTCONFIG
	bool "SUSFS spoof cmdline/bootconfig"
	default y

config KSU_SUSFS_OPEN_REDIRECT
	bool "SUSFS open_redirect"
	default y

config KSU_SUSFS_SUS_OVERLAYFS
	bool "SUSFS sus_overlayfs"
	default y

config KSU_SUSFS_HAS_MAGIC_MOUNT
	bool "SUSFS has magic mount"
	default n

endif # KSU_SUSFS
endmenu
```
